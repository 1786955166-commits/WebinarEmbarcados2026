## app/build/Kconfig/Kconfig.shield
```kconfig
osource "/home/jaga/Workspace/work/29-PortalEmbarcados/WebinarEmbarcados2026/boards/shields/*/Kconfig.shield"
```

## app/build/Kconfig/boards/Kconfig.defconfig
```kconfig
# Load Zephyr board defconfig descriptions.
osource "/home/jaga/Workspace/work/27-GZM/WebinarEmbarcados2026/boards/raspberrypi/dev_rpi_pico/Kconfig.defconfig"
```

## app/build/Kconfig/boards/Kconfig.sysbuild
```kconfig
# Load Sysbuild board Kconfig descriptions.
osource "/home/jaga/Workspace/work/29-PortalEmbarcados/WebinarEmbarcados2026/boards/raspberrypi/dev_rpi_pico/Kconfig.sysbuild"
```

## app/build/Kconfig/boards/Kconfig.sysbuild.tmp
```kconfig
# Load Sysbuild board Kconfig descriptions.
osource "/home/jaga/Workspace/work/27-GZM/WebinarEmbarcados2026/boards/raspberrypi/dev_rpi_pico/Kconfig.sysbuild"
```

## boards/raspberrypi/dev_rpi_pico/Kconfig
```kconfig
# SPDX-License-Identifier: Apache-2.0

config BOARD_DEV_RPI_PICO
	select RP2_FLASH_W25Q080
```

## boards/raspberrypi/dev_rpi_pico/Kconfig.dev_rpi_pico
```kconfig
# SPDX-License-Identifier: Apache-2.0

config BOARD_DEV_RPI_PICO
	select SOC_RP2040
```

## boards/raspberrypi/dev_rpi_pico/board.yml
```yaml
board:
  name: dev_rpi_pico
  full_name: Dev Raspberry Pi Pico W
  vendor: raspberrypi
  socs:
    - name: rp2040
      variants:
        - name: w
```

## lib/Kconfig
```kconfig
# SPDX-License-Identifier: Apache-2.0

menu "Custom Libraries (gzm)"

rsource "common/Kconfig"
rsource "rtc_mgr/Kconfig"
rsource "wifi_mgr/Kconfig"
rsource "fs_mgr/Kconfig"
rsource "ringtone/Kconfig"

endmenu
```

## lib/common/Kconfig
```kconfig
config GZM_COMMON
	bool "GZM common utilities"
	default n
	help
	  Foundation library with shared types and pure helpers used
	  across multiple gzm libraries. Designed as a leaf dependency:
	  any gzm library can `select GZM_COMMON` without pulling in
	  transitive feature requirements.
```

## lib/ringtone/Kconfig
```kconfig
config GZM_RINGTONE
	bool "Ringtone player (PWM buzzer + RTTTL)"
	depends on PWM
	default n
	help
	  Enable the ringtone player library for PWM-driven passive
	  buzzers with RTTTL melody playback support.

	  Provides: ringtone_init, ringtone_set_volume,
	  ringtone_play_custom (RTTTL string), ringtone_play_notification
	  (predefined alerts), ringtone_stop, ringtone_wait_done.

	  Shell commands (under `ringtone`) are available when CONFIG_SHELL
	  is also enabled.

	  Formerly: zlib/xbuzzer (CONFIG_ZLIB_XBUZZER).

config GZM_RINGTONE_THREAD_STACK_SIZE
	int "Ringtone player thread stack size"
	depends on GZM_RINGTONE
	default 1024
	help
	  Stack size for the ringtone playback thread.
	  Increase when using coverage instrumentation (gcov).
```

## lib/rtc_mgr/Kconfig
```kconfig
config GZM_RTC_MGR
	bool "RTC manager (datetime manipulation, formatting, conversion)"
	depends on RTC
	default n
	help
	  RTC manager with field-by-field setters, timestamp/rtc_time
	  conversion, string formatting, and leap year helper.

	  Formerly: zlib/xrtc (CONFIG_ZLIB_XRTC).
```

## lib/wifi_mgr/Kconfig
```kconfig
config GZM_WIFI_MGR
	bool "Enable XWIFI library"
	depends on WIFI
	select GZM_COMMON
	default n
	help
	  Enable the XWIFI library for WiFi operations.

config GZM_WIFI_MGR_TEST_HOOKS
	bool "Enable wifi_mgr test hooks (for ztest only)"
	depends on GZM_WIFI_MGR
	default n
	help
	  Exposes wifi_mgr_test_post_event() so tests can inject synthetic
	  events into the internal queue without going through net_mgmt
	  callbacks. Should remain disabled in production builds.
```
